## kernel/Kconfig.userinfo
```kconfig
config USERINFO
	tristate
        bool "Returns user info (number of processes, file descriptors and pending signals"
        default y
        help
            Returns user info
```
